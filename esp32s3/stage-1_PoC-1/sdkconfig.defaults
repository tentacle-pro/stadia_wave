## esp32s3/stage-1_PoC-2/sdkconfig.defaults
```kconfig
# ESP32-S3-N16R8 Stage-1 PoC-2: Wi-Fi SoftAP + NimBLE Provisioner

# Flash & Octal PSRAM (N16R8)
CONFIG_ESPTOOLPY_FLASHSIZE_16MB=y
CONFIG_PARTITION_TABLE_CUSTOM=y
CONFIG_PARTITION_TABLE_CUSTOM_FILENAME="partitions.csv"
CONFIG_SPIRAM=y
CONFIG_SPIRAM_MODE_OCT=y
CONFIG_SPIRAM_SPEED_80M=y

# NimBLE Central only
CONFIG_BT_ENABLED=y
CONFIG_BT_BLUEDROID_ENABLED=n
CONFIG_BT_NIMBLE_ENABLED=y
CONFIG_BT_NIMBLE_MAX_CONNECTIONS=1
CONFIG_BT_NIMBLE_ROLE_PERIPHERAL=n
CONFIG_BT_NIMBLE_ROLE_BROADCASTER=n
CONFIG_BT_NIMBLE_ATT_PREFERRED_MTU=517

# Wi-Fi + BLE Software Coexistence
CONFIG_ESP_COEX_SW_COEXIST_ENABLE=y
```
